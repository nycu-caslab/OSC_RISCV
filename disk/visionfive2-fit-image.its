## disk/visionfive2-fit-image.its
```
/dts-v1/;

/ {
        description = "U-boot FIT image for visionfive2";
        #address-cells = <2>;

        images {
                kernel {
                        description = "kernel";
                        data = /incbin/("./kernel.img");
                        type = "kernel";
                        arch = "riscv";
                        os = "linux";
                        load = <0x0 0x80200000>;
                        entry = <0x0 0x80200000>;
                        compression = "none";
                };

                fdt {
                        description = "fdt";
                        data = /incbin/("./jh7110-starfive-visionfive-2-v1.3b.dtb");
                        type = "flat_dt";
                        arch = "riscv";
                        load = <0x0 0x46000000>;
                        compression = "none";
                        hash-1 {
                                algo = "sha256";
                        };
                };
        };

        configurations {
                default = "config-1";

                config-1 {
                        description = "visionfive2 with opensbi";
                        kernel = "kernel";
                        fdt = "fdt";
                        loadables = "kernel";
                };
        };
};
```
